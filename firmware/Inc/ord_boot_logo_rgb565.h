/**
 * @file ord_boot_logo_rgb565.h
 * @brief Open Retro Diag (FDD Master Tester Rev 1.0) 160x80 60FPS RGB565 Boot Logo
 *        Compact 2-bit/pixel mask (3,200 bytes Flash) + Dynamic Gradient Shader
 * @author Alessio Iodice <alessio67@gmail.com>
 * @note Validated on STM32F407VET6 / KiCad 9.0 Platform
 */
#ifndef ORD_BOOT_LOGO_RGB565_H
#define ORD_BOOT_LOGO_RGB565_H

#include <stdint.h>

#define ORD_LCD_WIDTH   160u
#define ORD_LCD_HEIGHT  80u

/* 256-entry precomputed RGB565 Gradient LUT (Ruby -> Orange -> Gold -> Emerald -> Cyan) */
static const uint16_t k_ord_gradient_lut[256] = {
    0xF930u, 0xF930u, 0xF930u, 0xF930u, 0xF930u, 0xF930u, 0xF930u, 0xF950u, 0xF950u, 0xF950u, 0xF950u, 0xF94Fu,
    0xF96Fu, 0xF96Fu, 0xF96Fu, 0xF98Fu, 0xF98Fu, 0xF98Eu, 0xF9AEu, 0xF9AEu, 0xF9CEu, 0xF9CDu, 0xF9CDu, 0xF9EDu,
    0xF9EDu, 0xFA0Cu, 0xFA0Cu, 0xFA2Cu, 0xFA2Bu, 0xFA4Bu, 0xFA4Bu, 0xFA6Au, 0xFA6Au, 0xFA8Au, 0xFA8Au, 0xFAA9u,
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    0xF171u, 0xF951u, 0xF931u, 0xF930u
};

/* 2-bit packed pixel layer map (0=BG, 1=FDD_Emblem, 2=Bus_Traces, 3=Typography): 3200 bytes */
static const uint8_t k_ord_logo_mask_2bpp[3200] = {
    0x00u, 0x00u, 0x00u, 0x00u, 0x00u, 0x00u, 0x00u, 0x00u, 0x00u, 0x00u, 0x00u, 0x00u, 0x00u, 0x00u, 0x00u, 0x00u,
    0x00u, 0x00u, 0x00u, 0x00u, 0x00u, 0x00u, 0x00u, 0x00u, 0x00u, 0x00u, 0x00u, 0x00u, 0x00u, 0x00u, 0x00u, 0x00u,
    0x00u, 0x00u, 0x00u, 0x00u, 0x00u, 0x00u, 0x00u, 0x00u, 0x00u, 0x00u, 0x00u, 0x00u, 0x00u, 0x00u, 0x00u, 0x00u,
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    0x00u, 0x00u, 0x00u, 0x00u, 0x00u, 0x00u, 0x00u, 0x00u, 0x00u, 0x00u, 0x00u, 0x00u, 0x00u, 0x00u, 0x00u, 0x00u
};

/**
 * @brief Renders the RETRO DIAG boot splash frame with gradient shader
 * @param fb Pointer to 160x80 RGB565 framebuffer (25,600 bytes)
 * @param frame_tick Frame counter or animation phase for the gradient shader
 */
static inline void ord_boot_render_frame(uint16_t *fb, uint32_t frame_tick) {
    if (!fb) return;
    uint32_t byte_idx = 0U;
    for (uint16_t y = 0U; y < ORD_LCD_HEIGHT; y++) {
        uint16_t row_offset = (uint16_t)(y * ORD_LCD_WIDTH);
        for (uint16_t x_grp = 0U; x_grp < (ORD_LCD_WIDTH / 4U); x_grp++) {
            uint8_t b = k_ord_logo_mask_2bpp[byte_idx++];
            for (uint8_t p = 0U; p < 4U; p++) {
                uint16_t x = (uint16_t)(x_grp * 4U + p);
                uint8_t val = (uint8_t)((b >> (6U - p * 2U)) & 0x03U);
                uint16_t color;
                switch (val) {
                    case 0U: /* Background: Obsidian Dark Scanlines */
                        color = (y & 1U) ? 0x0862U : 0x0020U;
                        break;
                    case 1U: /* FDD Emblem & Flux Pulse: Dynamic Rainbow Gradient */
                        color = k_ord_gradient_lut[(x + (frame_tick * 2U)) & 0xFFU];
                        break;
                    case 2U: /* Bus Traces & Vias: Electric Cyan / Blue */
                        color = 0x0BEFU;
                        break;
                    case 3U: /* Typography & Subtitle: Crisp Luminescent White */
                    default:
                        color = 0xF79EU;
                        break;
                }
                fb[row_offset + x] = color;
            }
        }
    }
}

#endif /* ORD_BOOT_LOGO_RGB565_H */
